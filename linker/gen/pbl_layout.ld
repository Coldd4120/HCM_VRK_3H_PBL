/* GENERATED by tools/layout/gen_layout.py from common/boot/layout.json.
 * DO NOT EDIT: change layout.json and regenerate; check_fota_layout.py R5
 * fails on any hand edit.
 * INCLUDEd at top level of linker/pbl_s32k338.ld.
 * layout_name VRK_S32K338_ABSWAP_CAND1_CANDIDATE, sha256 56ff73efcec903807d81226c8ec52f45f5aa6bfa0e6c194c0f5eb1a9aa80109e
 */
MEMORY
{
  PBL_FLASH (rx)  : ORIGIN = 0x00400000, LENGTH = 0x00040000
  PBL_SRAM  (rwx) : ORIGIN = 0x20420000, LENGTH = 0x00010000
  PBL_DTCM  (rwx) : ORIGIN = 0x20000000, LENGTH = 0x00010000
}
PBL_LAYOUT_VECTOR_OFFSET = 0x00002000;
PBL_LAYOUT_ID            = 0x5222308B;
PBL_LAYOUT_APPROVED      = 0;
